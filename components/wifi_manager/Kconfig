## components/wifi_manager/Kconfig
```kconfig
menu "WiFi Manager Configuration"

config WMNGR_TASK
    bool "Run WiFi Manager as Task"
    default true
	help
		Create a dedicated task for WiFi Manager. If not set,
		WiFi Manager will use the system timer and may interfere
		with other processes. If unsure, say Y

config WMNGR_TASK_STACK
	int "WiFi Manager task stack size"
	default 2048
	depends on WMNGR_TASK
	
config WMNGR_AP_SSID
    string "WiFi Manager default AP SSID"
	default "ESP WiFi Manager"

config WMNGR_AP_IP
    string "WiFi Manager default AP IP address"
	default "192.168.4.1"

config WMNGR_AP_GW
    string "WiFi Manager default AP gateway"
	default "192.168.4.1"

config WMNGR_AP_MASK
    string "WiFi Manager default AP netmask"
	default "255.255.255.0"


endmenu
```

## main/Kconfig.projbuild
```kconfig
menu "Hephaistos Configuration"

config FBOX_ADDR
    string "Default F!Box Address"
    default "192.168.178.1"
	help
		IP address of F!Box.

config FBOX_PORT
    string "Default F!Box Port"
	default "80"
	help
		Port to connect to on F!Box.

config GPIO_HEAT
    int "Heater Control Pin"
	default 18
	help
		GPIO pin used for controlling heater. 

config GPIO_LED
    int "LED Control Pin"
	default 19
	help
		GPIO pin used for controlling info LED.

config GPIO_FW_RESET
    int "Factory Reset Button Pin"
	default 0
	help
		GPIO pin used for factory reset button.

config TIMEZONE
    string "Time Zone"
	default "CET+1CEST,M3.5.0/2,M10.5.0"
	help
		Local time zone. Defaults to Europe/Berlin.


config HYSTERESIS
    int "Hysteresis time"
	default 300
	help
		Hysteresis time in seconds.


endmenu
```
